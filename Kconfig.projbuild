## Kconfig.projbuild
```kconfig
menu "OpenCO2Monitor config"

config OPENCO2_MONITOR_ENABLESECUREWIFIPROVISIONING
    bool "Enable Secure Provisioning"
    default n
    select OPENCO2_MONITOR_ENABLESECUREWIFIPROVISIONING
    help
        Enable this option for secure Wifi provisioning to use a WPA2 PSK network whilst provisioning. Requires an SSD1306 display to display the randomly generated Wifi password
        
endmenu
```

## boards/esp32-idf/sdkconfig.defaults
```kconfig
#
# PThreads
#
CONFIG_ENABLE_PTHREAD=y

#
# Partition Table
#
CONFIG_PARTITION_TABLE_TWO_OTA=y

#
# Bootloader config
#
CONFIG_BOOTLOADER_APP_TEST=y
CONFIG_BOOTLOADER_APP_TEST_IN_OTA_1=y
CONFIG_BOOTLOADER_NUM_PIN_APP_TEST=12
#
# AirQuality.Dev
#
CONFIG_CO2_UART_ENABLE=y
CONFIG_CO2_UART_NUM=2
CONFIG_CO2_UART_SENSEAIR=y
CONFIG_CO2_UART_CUBIC=y
CONFIG_CO2_UART_WINSEN=y

#
# I2C Bus
#
CONFIG_I2C_SDA_PIN=21
CONFIG_I2C_SCL_PIN=22
# end of I2C Bus
# end of AirQuality.Dev
# end of Component config
```

## components/EPD/Kconfig
```kconfig
menu "Display Configuration"
    comment "Fill only EPD entries for single SPI displays (Good display/Waveshare)"
    comment "Mosi and Clock should be set for any epaper"
    config EINK_SPI_MOSI
        int "EPD SPI: GPIO for MOSI (DIN in epaper) * Universal MOSI"
        range 0 35
        default 23
    config EINK_SPI_CLK
        int "EPD SPI: GPIO for Clock                * Universal CLK"
        range 0 37
        default 18
    config EINK_SPI_CS
        int "EPD SPI: GPIO for Chip Select"
        range -1 34
        default 32
    config EINK_DC
        int "EPD: GPIO for DC"
        range -1 34
        default 27
    config EINK_RST
        int "EPD: GPIO for Reset"
        range -1 34
        default 26
    config EINK_BUSY
        int "EPD: GPIO for Busy signal - DONE for Good Display/Waveshare einks! Leave rest on 0 unless is Wave12I48 or PlasticLogic"
        range -1 39
        default 35
endmenu
```

## main/Kconfig
```kconfig
menu "AirQuality.Dev"

    config CO2_UART_ENABLE
        bool "Enable UART CO2 Sensors"
        default y

    config CO2_UART_NUM
        depends on CO2_UART_ENABLE
        int "UART Number"
        range 0 2
        default 2
        help
            The RX/TX pin pair to use for communication with the CO2 sensor
 
    config CO2_UART_SENSEAIR
        depends on CO2_UART_ENABLE
        bool "Enable UART Support for Senseair Sunrise"
        default y
        help    
            Enables support for the Senseair Sunrise sensor. This is a low power 3.3v sensor.


    config CO2_UART_CUBIC
        depends on CO2_UART_ENABLE
        bool "Enable Cubic UART Support"
        default y
                
    config CO2_UART_WINSEN
        depends on CO2_UART_ENABLE
        bool "Enable Cubic UART Support"
        default y

    menu "I2C Bus"
        config I2C_SDA_PIN
            int "SDA GPIO Number"
            range 0 39
            default 21
            help
                The GPIO PIN to use as SDA for the I2C bus.

        config I2C_SCL_PIN
            int "SCL GPIO Number"
            range 0 39
            default 22
            help
                The GPIO PIN to use as SDL for the I2C bus.      
    endmenu
endmenu
```
